#include "reg52.h"
#include "SMG.h"

uint __locketi = 0;

uchar code SMG_CODE[17]={0x3F,0x06,0x5B,0x4F,0x66,0x6D,0x7D,0x07,0x7F,0x6F,0x77,0x7C,0x39,0x5E,0x79,0x71,0x00};
uchar SMG_ROM[8]={0x00,0x00,0x00,0x00,0x00,0x00,0x00};

/***************************************************************************************************    
函数名称：	delay
功能描述：	数码管延时（强烈不建议使用，会影响程序主时序）
维护记录：  2019-4-27
***************************************************************************************************/
void delay(uint time)         //int型数据为16位,所以最大值为65535            
 {
  uint  i,j;             //定义变量i,j,用于循环语句 
  for(i=0;i<time;i++)    //for循环,循环50*time次
     for(j=0;j<50;j++);  //for循环,循环50次
 }
/***************************************************************************************************    
函数名称：	SetData
功能描述：	设置locketi位置上的数据Data
参数说明：	locketi  int  位置
			Data	int		数据（0~15分别对应0~F，16为空）
维护记录：  2019-4-27
***************************************************************************************************/
void SetData(int locketi, int Data)
{
    SMG_ROM[locketi] = SMG_CODE[Data];
}
/***************************************************************************************************    
函数名称：	SMG_scan
功能描述：	数码管刷新（一般交由定时器系统调用）
参数说明：	无
维护记录：  2019-4-27
***************************************************************************************************/
void SMG_scan()
{
	SetLocket(__locketi);	
    SMG_PORT=SMG_ROM[__locketi];        
	DATALock=1;
	DATALock=0;

	__locketi++;                   //位置加1
	if(__locketi>7)
	{
		__locketi = 0;
	}	
    delay(10);               //延时保持一下,延时过大会闪动，延时过小会有暗影    
}
/***************************************************************************************************    
函数名称：	SetLocket
功能描述：	数码管位选（仅由数码管刷新函数调用）
参数说明：	locketi int 数码管当前刷新位置
维护记录：  2019-4-27
***************************************************************************************************/
void SetLocket(int locketi)
{
	uchar Locate; 
	Locate= LOC<<locketi;				 //左移i位
	SMG_PORT=~Locate;                //由于共阴，低电平来选通某1位，所以需取反  
	LocateLock=1;					         //锁存位
    LocateLock=0;                    //断开锁存,位选573的Q7~Q0仍保持                    
}

